## app/boards/arm/bt10/Kconfig.board
```kconfig
# BT10 board configuration

# Copyright (c) 2021 Polarity Works
# SPDX-License-Identifier: MIT

config BOARD_BT10
	bool "bt10"
	depends on SOC_NRF52840_QIAA
```
